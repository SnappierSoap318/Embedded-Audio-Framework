## platform/esp_idf_bt/components/main/Kconfig.projbuild
```kconfig
menu "EAF ESP-IDF Bluetooth board"

config EAF_I2S_BCLK_GPIO
    int "I2S BCLK GPIO"
    default 26
    help
      Defaults match the WROVER + TAS5805M carrier: WS=25, BCLK=26, DOUT=22.

config EAF_I2S_WS_GPIO
    int "I2S WS (LRCLK) GPIO"
    default 25

config EAF_I2S_DOUT_GPIO
    int "I2S serial data output GPIO"
    default 22

config EAF_BT_DEVICE_NAME
    string "Bluetooth device name"
    default "EAF Bluetooth Speaker"

config EAF_AMP_SDA_GPIO
    int "TAS5805M I2C SDA GPIO"
    default 21

config EAF_AMP_SCL_GPIO
    int "TAS5805M I2C SCL GPIO"
    default 27

config EAF_AMP_PWDN_GPIO
    int "TAS5805M power-down GPIO"
    default 33

config EAF_AMP_FAULT_GPIO
    int "TAS5805M fault GPIO (external pull-up)"
    default 34

config EAF_AMP_I2C_ADDRESS
    hex "TAS5805M I2C address"
    default 0x2d
    range 0x2c 0x2f

config EAF_BT_SAMPLE_RATE
    int "A2DP sample rate (44100 or 48000)"
    default 44100
    range 44100 48000

config EAF_BT_BLOCK_FRAMES
    int "I2S block size in frames per channel"
    default 128
    range 16 1024

config EAF_BT_RESERVOIR_FRAMES
    int "Jitter reservoir capacity in frames (power of two)"
    default 4096
    range 512 65536

endmenu
```

## platform/esp_idf_sendspin/components/eaf/Kconfig
```kconfig
menu "EAF framework"

config EAF_THREAD_COUNT
    int "EAF static thread slots"
    default 4
    range 1 16

config EAF_THREAD_STACK_SIZE
    int "EAF worker stack size in bytes"
    default 4096
    range 1024 65536

config EAF_SEM_COUNT
    int "EAF static binary semaphore slots"
    default 4
    range 1 16

config EAF_AUDIO_PRIORITY
    int "FreeRTOS priority for EAF audio workers"
    default 10
    range 1 24
    help
      FreeRTOS preempts lower numeric priorities, so this must exceed
      CONFIG_EAF_DECODER_PRIORITY and stay below configMAX_PRIORITIES (25).

config EAF_DECODER_PRIORITY
    int "FreeRTOS priority for EAF decoder workers"
    default 8
    range 1 23

config EAF_I2S_MAX_FRAMES
    int "Maximum I2S block size in frames per channel"
    default 128
    range 16 1024

endmenu
```

## platform/esp_idf_sendspin/components/main/Kconfig.projbuild
```kconfig
menu "EAF ESP-IDF Sendspin board"

config EAF_I2S_BCLK_GPIO
    int "I2S BCLK GPIO"
    default 26
    help
      Defaults match the WROVER + TAS5805M carrier: WS=25, BCLK=26, DOUT=22.

config EAF_I2S_WS_GPIO
    int "I2S WS (LRCLK) GPIO"
    default 25

config EAF_I2S_DOUT_GPIO
    int "I2S serial data output GPIO"
    default 22

config EAF_SMOKE_SAMPLE_RATE
    int "Smoke-test sample rate"
    default 44100
    range 8000 192000

config EAF_SMOKE_BLOCKS
    int "Smoke-test tone blocks"
    default 64
    range 1 100000

endmenu
```

## west.yml
```yaml
manifest:
  version: "0.13"
  projects:
    - name: zephyr
      url: https://github.com/zephyrproject-rtos/zephyr
      revision: v4.3.0
      import: true
  self:
    path: eaf
```

## zephyr/Kconfig
```kconfig
menuconfig EAF
	bool "Embedded Audio Framework"
	default y
	select REQUIRES_STD_C11

if EAF
config EAF_THREAD_COUNT
	int "Maximum simultaneous EAF worker threads"
	default 2
	range 1 8
config EAF_THREAD_STACK_SIZE
	int "Worker stack size in bytes"
	default 4096
	range 2048 65536
config EAF_DECODER_PRIORITY
	int "Decoder preemptive priority"
	default 5
	range 0 14
config EAF_AUDIO_PRIORITY
	int "Audio preemptive priority (must be lower numerically than decoder)"
	default 3
	range 0 13
config EAF_SEM_COUNT
	int "Maximum EAF binary wake semaphores"
	default 4
	range 1 16
config EAF_LMS
	bool "Bounded SlimProto control protocol"
	default y
config EAF_I2S
	bool "Static stereo I2S TX sink"
	depends on I2S
config EAF_LMS_CLIENT
	bool "LMS TCP/HTTP raw PCM client"
	depends on EAF_LMS && NET_SOCKETS
config EAF_LMS_INGRESS_BYTES
	int "Raw PCM ingress ring bytes for the LMS client"
	default 4096
	range 1024 65536
	depends on EAF_LMS_CLIENT
	help
	  Fixed raw source-PCM buffer between the socket and the output callback.
	  The transport keeps draining the socket into this ring while the output
	  reservoir is backpressured, so the server's TCP window stays open. Boards
	  without PSRAM should size it within internal RAM.
config EAF_BT_A2DP
	bool "Zephyr Classic A2DP SBC sink binding"
	depends on EAF_BT_INGRESS && BT_CLASSIC && BT_A2DP_SINK
	help
	  Register a fixed-rate SBC endpoint and copy incoming media to EAF.
	  The board application owns SDP, pairing and decoder/audio workers.
config EAF_BT_SBC
	bool "SBC decode worker"
	depends on EAF_BT_INGRESS && ZEPHYR_LIBSBC_MODULE
	select LIBSBC_DECODER
config EAF_I2S_MAX_FRAMES
	int "Maximum I2S block frames"
	default 256
	range 32 1024
	depends on EAF_I2S
config EAF_BT_INGRESS
	bool "Bounded Bluetooth SBC media ingress"
	default y
endif
```
