## CMakeLists.txt
```
cmake_minimum_required(VERSION 3.20.0)
list(APPEND ZEPHYR_EXTRA_MODULES ${CMAKE_CURRENT_LIST_DIR}/../..)
find_package(Zephyr REQUIRED HINTS $ENV{ZEPHYR_BASE})
project(eaf_esp32_lms)
# Keep the optional silent backend within the WROOM budget; match all TUs.
zephyr_compile_definitions(EAF_NULL_MAX_FRAMES=128u)
set(EAF_PRIVATE_CONFIG "${CMAKE_CURRENT_SOURCE_DIR}/credentials.local.h" CACHE FILEPATH "Local Wi-Fi credentials header")
if(EXISTS "${EAF_PRIVATE_CONFIG}")
  configure_file("${EAF_PRIVATE_CONFIG}" private/credentials.h COPYONLY)
else()
  configure_file(credentials.example.h private/credentials.h COPYONLY)
  message(STATUS "No local Wi-Fi credentials: image builds but will not connect")
endif()
target_include_directories(app PRIVATE ${CMAKE_CURRENT_BINARY_DIR}/private)
target_sources(app PRIVATE src/main.c src/output.c)
target_sources(app PRIVATE ${CMAKE_CURRENT_SOURCE_DIR}/../esp32_output/board_output.c)
target_sources(app PRIVATE ${CMAKE_CURRENT_SOURCE_DIR}/../esp32_common/log_buffer.c
  ${CMAKE_CURRENT_SOURCE_DIR}/../esp32_common/diagnostics.c
  ${CMAKE_CURRENT_SOURCE_DIR}/../esp32_common/wifi_bootstrap.c
  ${CMAKE_CURRENT_SOURCE_DIR}/../esp32_common/board_runtime.c)
target_include_directories(app PRIVATE ${CMAKE_CURRENT_SOURCE_DIR}/../esp32_output
  ${CMAKE_CURRENT_SOURCE_DIR}/../esp32_common
  ${CMAKE_CURRENT_SOURCE_DIR}/../../hal/zephyr)
if(CONFIG_EAF_BOARD_I2S)
  target_sources(app PRIVATE ${CMAKE_CURRENT_SOURCE_DIR}/../esp32_output/sink_i2s.c)
else()
  target_sources(app PRIVATE ${CMAKE_CURRENT_SOURCE_DIR}/../esp32_output/sink_null.c)
endif()
if(CONFIG_EAF_BOARD_USE_PSRAM)
  target_sources(app PRIVATE ${CMAKE_CURRENT_SOURCE_DIR}/../esp32_output/storage_psram.c)
else()
  target_sources(app PRIVATE ${CMAKE_CURRENT_SOURCE_DIR}/../esp32_output/storage_internal.c)
endif()
if(CONFIG_WIFI_ESP32)
  target_sources(app PRIVATE ${CMAKE_CURRENT_SOURCE_DIR}/../esp32_common/wifi_power_esp32.c)
else()
  target_sources(app PRIVATE ${CMAKE_CURRENT_SOURCE_DIR}/../esp32_common/wifi_power_stub.c)
endif()
if(CONFIG_BOOTLOADER_MCUBOOT)
  target_sources(app PRIVATE ${CMAKE_CURRENT_SOURCE_DIR}/../esp32_common/ota_mcuboot.c)
else()
  target_sources(app PRIVATE ${CMAKE_CURRENT_SOURCE_DIR}/../esp32_common/ota_stub.c)
endif()

target_include_directories(app SYSTEM PRIVATE ${ZEPHYR_BASE}/include)
target_compile_options(app PRIVATE -Wall -Wextra -Werror -Wconversion -Wstrict-prototypes -Wshadow -Wdouble-promotion)
```

## Kconfig
```
mainmenu "EAF WROOM LMS player"
config EAF_I2S_MAX_FRAMES
    default 128
source "Kconfig.zephyr"
config EAF_BOARD_I2S
    bool "Audible I2S output (otherwise timed null)"
    default y
    select I2S
    select EAF_I2S
config EAF_BOARD_SERVER
    string "LMS numeric IPv4 address"
    default ""
    help
      Lyrion Music Server IPv4 address. Required. Provide it locally, for
      example with a local override file passed as
      -DEXTRA_CONF_FILE=local.conf containing
      CONFIG_EAF_BOARD_SERVER="192.168.1.10".
config EAF_BOARD_WIFI_PS_NONE
    bool "Disable Wi-Fi modem sleep for lower latency"
    default y
    help
      ESP-IDF defaults to WIFI_PS_MIN_MODEM, which wakes only at the AP DTIM
      period. On a mains-powered player, disabling power save removes those
      periodic receive stalls at the cost of higher idle current.
config EAF_BOARD_AUDIO_CPU
    int "Audio worker CPU (-1 unrestricted)"
    default -1
    help
      With CONFIG_SMP and CONFIG_SCHED_CPU_MASK, pin the audio owner to this
      CPU so network and decoder work cannot preempt it. -1 leaves it
      unrestricted (required on single-core builds).
config EAF_BOARD_MAIN_CPU
    int "Main/transport CPU (-1 unrestricted)"
    default -1
    help
      Pin the main transport thread (and its diagnostics web thread) away from
      the audio CPU when SMP affinity is available.
config EAF_BOARD_RESERVOIR_FRAMES
    int "Output reservoir capacity in frames (power of two)"
    default 4096
    range 512 1048576
    help
      Stereo Q1.31 output reservoir capacity. It also caps the startup
      prefill, so it must cover the LMS stream/output thresholds the board
      wants to honor. Must be a power of two.
config EAF_BOARD_USE_PSRAM
    bool "Place the output reservoir in external SPI RAM"
    default n
    depends on ESP_SPIRAM
    help
      Allocate the reservoir from the ESP32 external RAM shared heap instead of
      internal DRAM. Enables the large-buffer WROVER profile; requires a board
      build with CONFIG_ESP_SPIRAM and PSRAM fitted.
```

## prj.conf
```kconfig
CONFIG_EAF=y
CONFIG_EAF_LMS=y
CONFIG_EAF_LMS_CLIENT=y
CONFIG_EAF_BT_INGRESS=n
CONFIG_EAF_BT_SBC=n
CONFIG_EAF_BT_A2DP=n
CONFIG_EAF_THREAD_COUNT=1
CONFIG_EAF_THREAD_STACK_SIZE=4096
CONFIG_MAIN_STACK_SIZE=6144
CONFIG_MAIN_THREAD_PRIORITY=5
CONFIG_EAF_SEM_COUNT=1
CONFIG_ASSERT=y
CONFIG_THREAD_STACK_INFO=y
CONFIG_INIT_STACKS=y
CONFIG_REQUIRES_FULL_LIBC=y
CONFIG_WIFI=y
CONFIG_NET_L2_WIFI_MGMT=y
CONFIG_NETWORKING=y
CONFIG_NET_IPV4=y
CONFIG_NET_IPV6=n
CONFIG_NET_TCP=y
CONFIG_NET_DHCPV4=y
CONFIG_NET_SOCKETS=y
CONFIG_NET_MGMT=y
CONFIG_NET_MGMT_EVENT=y
CONFIG_NET_MGMT_EVENT_INFO=y
CONFIG_NET_MAX_CONTEXTS=10
CONFIG_NET_MAX_CONN=12
CONFIG_NET_PKT_RX_COUNT=12
CONFIG_NET_PKT_TX_COUNT=8
CONFIG_NET_BUF_RX_COUNT=64
CONFIG_NET_BUF_TX_COUNT=16
CONFIG_NET_BUF_DATA_SIZE=256
CONFIG_NET_TCP_MAX_RECV_WINDOW_SIZE=8192
CONFIG_NET_CONTEXT_RCVTIMEO=y
CONFIG_NET_CONTEXT_SNDTIMEO=y
CONFIG_HEAP_MEM_POOL_SIZE=65536
```

## psram.conf
```kconfig
# WROVER-IE / ESP32-WROVER-E (N16R8 or similar) profile.
#
# Enable the 8 MB SPI RAM and place the stereo Q1.31 output reservoir there.
# The reservoir also caps the startup prefill, so 65536 frames (about 1.48 s
# of 44.1 kHz stereo source) covers the LMS stream threshold the WROOM profile
# has to clamp.
#
# Build with:
#   cmake ... -DEXTRA_CONF_FILE=psram.conf -DEXTRA_DTC_OVERLAY_FILE=psram.overlay

CONFIG_ESP_SPIRAM=y
CONFIG_ESP_SPIRAM_MEMTEST=y
CONFIG_ESP_SPIRAM_HEAP_SIZE=2097152

CONFIG_EAF_BOARD_USE_PSRAM=y
CONFIG_EAF_BOARD_RESERVOIR_FRAMES=65536
```

## boards/esp32_devkitc_esp32_procpu.conf
```kconfig
# WROOM has no external RAM. The upstream DevKitC template names a WROVER.
CONFIG_ESP_SPIRAM=n
CONFIG_ESP_SIMPLE_BOOT=y
CONFIG_ESPTOOLPY_FLASHSIZE_4MB=y
CONFIG_ESPTOOLPY_FLASHMODE_DIO=y
CONFIG_ESPTOOLPY_FLASHFREQ_40M=y
CONFIG_ESP32_WIFI_STATIC_RX_BUFFER_NUM=4
CONFIG_ESP32_WIFI_DYNAMIC_RX_BUFFER_NUM=8
CONFIG_ESP32_WIFI_DYNAMIC_TX_BUFFER_NUM=8

# The application owns DHCP and retry timing.
CONFIG_ESP32_WIFI_STA_AUTO_DHCPV4=n
CONFIG_ESP32_WIFI_STA_RECONNECT=n

# TCP receive window must be backed by enough RX buffers. The upstream 8 KiB
# window holds only ~46 ms of 44.1 kHz/16-bit stereo, capping HTTP intake near
# window/RTT (~80 KB/s at the observed ~100 ms RTT) below the 176 KB/s needed.
# Phase 1a: double the window and grow the RX pool to back it.
CONFIG_NET_TCP_MAX_RECV_WINDOW_SIZE=16384
CONFIG_NET_BUF_RX_COUNT=96
CONFIG_NET_PKT_RX_COUNT=24

# Keep draining the socket while the output reservoir is full so the server's
# TCP window stays open. Source PCM staging in internal RAM (no PSRAM here).
CONFIG_EAF_LMS_INGRESS_BYTES=16384

# Zephyr 4.3's ESP32 Wi-Fi driver depends on !SMP, so dual-core pinning is not
# available with networking. Keep audio above network work on the single core:
# the TCP worker default (2) outranks EAF audio (3); move it below.
CONFIG_NET_TCP_WORKER_PRIO=5
```

## src/main.c
```c
#include "board_runtime.h"
#include "diagnostics.h"
#include "output.h"
#include "wifi_bootstrap.h"
#include <string.h>
#include <zephyr/kernel.h>
#include <zephyr/net/net_if.h>

/* dhcpv4.h requires the net_if declaration first. */
#include <zephyr/net/dhcpv4.h>
#include <zephyr/net/net_mgmt.h>
#include <zephyr/net/wifi_mgmt.h>
#include <zephyr/sys/byteorder.h>
BUILD_ASSERT(!IS_ENABLED(CONFIG_BT), "Qualify Wi-Fi alone before enabling Bluetooth");
BUILD_ASSERT(!IS_ENABLED(CONFIG_EAF_BOARD_USE_PSRAM) || IS_ENABLED(CONFIG_ESP_SPIRAM),
             "PSRAM reservoir requires CONFIG_ESP_SPIRAM");
static eaf_lms_client_t client;
static board_wifi_t wifi;

int main(void) {
    if (CONFIG_EAF_BOARD_MAIN_CPU >= 0)
        (void)board_cpu_pin(k_current_get(), CONFIG_EAF_BOARD_MAIN_CPU);
    board_diagnostics_start();
    if (board_wifi_bind(&wifi) != EAF_OK)
        return 1;
    struct in_addr server;
    if (net_addr_pton(AF_INET, CONFIG_EAF_BOARD_SERVER, &server))
        return 1;
    const struct net_linkaddr *link = net_if_get_link_addr(wifi.iface);
    if (!link || link->len != 6)
        return 1;
    uint8_t mac[6];
    memcpy(mac, link->addr, sizeof(mac));
    if (board_output_init()) {
        board_log("Output initialization failed");
        return 1;
    }
    eaf_lms_callbacks_t cb = board_output_callbacks();
    if (eaf_lms_client_init(&client, &cb))
        return 1;
    board_log("EAF LMS board: player %02x:%02x:%02x:%02x:%02x:%02x, server %s:3483", mac[0], mac[1],
              mac[2], mac[3], mac[4], mac[5], CONFIG_EAF_BOARD_SERVER);
    for (;;) {
        int rc = board_wifi_online(&wifi) ? EAF_OK : board_wifi_connect(&wifi);
        if (!rc) {
            rc = eaf_lms_client_connect(&client, sys_be32_to_cpu(server.s_addr), 3483, mac);
            if (rc)
                board_log("LMS connect failed rc=%d server=%s:3483", rc, CONFIG_EAF_BOARD_SERVER);
        }
        if (!rc)
            board_log("LMS connected; select this player's MAC in the server UI");
        int64_t report = 0, diagnostic = 0, previous_diagnostic = k_uptime_get();
        uint64_t previous_bytes = client.diagnostics.http_bytes;
        bool eof_reported = false;
        while (!rc && board_wifi_online(&wifi) && !board_output_failed()) {
            eaf_lms_pump_result_t pump;
            rc = eaf_lms_client_pump(&client, 32, 1000, &pump);
            if (rc) {
                const eaf_lms_diagnostics_t *d = &client.diagnostics;
                board_log("LMS failure rc=%d stage=%u opcode=%02x%02x%02x%02x", d->first_error,
                          (unsigned)d->error_stage, d->error_opcode[0], d->error_opcode[1],
                          d->error_opcode[2], d->error_opcode[3]);
            }
            int64_t now = k_uptime_get();
            eaf_lms_playback_t snapshot;
            if (now >= diagnostic) {
                bool active = board_output_snapshot(&snapshot);
                const eaf_lms_diagnostics_t *d = &client.diagnostics;
                uint64_t span = (uint64_t)(now - previous_diagnostic);
                uint64_t rate = span ? (d->http_bytes - previous_bytes) * 1000u / span : 0;
                board_log_memory("RX=%llu B/s total=%llu again=%u backpressure=%u budget=%u",
                                 (unsigned long long)rate, (unsigned long long)d->http_bytes,
                                 d->recv_again, d->backpressure, d->budget_yields);
                board_log_memory(
                    "Output queued=%u min_frames=%u played_ms=%u underruns=%u failed=%u",
                    active ? snapshot.queued_bytes : 0u, board_output_queue_min(),
                    active ? snapshot.elapsed_ms : 0u, board_output_underruns(),
                    board_output_failed() ? 1u : 0u);
                board_log_memory("Worker flags=%u calls=%u HTTP=%u eof=%u gates=%u/%u",
                                 board_output_flags(), board_output_process_calls(),
                                 client.http.open ? 1u : 0u, client.input_eof ? 1u : 0u,
                                 client.wait_cont ? 1u : 0u, client.wait_start ? 1u : 0u);
                board_wifi_health(&wifi);
                previous_bytes = d->http_bytes;
                previous_diagnostic = now;
                diagnostic = now + 5000;
            }
            if (!rc && !client.wait_cont && !client.wait_start && now >= report &&
                board_output_snapshot(&snapshot)) {
                rc = eaf_lms_client_report_playback(&client, &snapshot);
                report = now + 1000;
            }
            /* One bounded record of what the server actually sent this stream. */
            if (!client.input_eof) {
                eof_reported = false;
            } else if (!eof_reported) {
                const eaf_lms_diagnostics_t *d = &client.diagnostics;
                board_log("HTTP status=%u len=%lu known=%u type=%s bytes=%llu pcm=%llu",
                          (unsigned)d->http_status, (unsigned long)d->http_content_length,
                          d->http_length_known ? 1u : 0u,
                          d->http_content_type[0] ? d->http_content_type : "(none)",
                          (unsigned long long)d->http_bytes, (unsigned long long)d->pcm_frames);
                eof_reported = true;
            }
            /* Yield to lower-priority diagnostics even during sustained intake.
               Idle/backpressure polls remain bounded; no fixed delay per recv. */
            k_sleep(pump.budget_exhausted ? K_TICKS(1) : K_MSEC(2));
        }
        eaf_lms_client_close(&client);
        if (board_output_failed()) {
            board_log("Output failure: playback stopped; inspect serial log and reset");
            return 1;
        }
        board_log("Connection ended (%d); retry in 5 seconds", rc);
        if (!board_wifi_online(&wifi)) {
            (void)net_mgmt(NET_REQUEST_WIFI_DISCONNECT, wifi.iface, NULL, 0);
            net_dhcpv4_stop(wifi.iface);
        }
        k_sleep(K_SECONDS(5));
    }
    return 0;
}
```

## src/credentials.c
```c
#include "credentials.h"
#include "output.h"
/* Separate TU keeps the no-credentials build's main path representative for
   link/memory checks. Private strings are never printed or passed to Kconfig. */
const char *board_wifi_ssid(void) {
    return EAF_WIFI_SSID;
}
const char *board_wifi_password(void) {
    return EAF_WIFI_PASSWORD;
}
```

## src/diagnostics.c
```c
#include "diagnostics.h"
#include <errno.h>
#include <string.h>
#include <zephyr/kernel.h>
#include <zephyr/net/socket.h>
BUILD_ASSERT(IS_ENABLED(CONFIG_NET_CONTEXT_RCVTIMEO) && IS_ENABLED(CONFIG_NET_CONTEXT_SNDTIMEO),
             "Web diagnostics require bounded socket waits");
static const char page[] =
    "<!doctype html><meta charset=utf-8><title>EAF diagnostics</title>"
    "<style>body{background:#101820;color:#e3edf5;font:16px monospace;margin:2em}"
    "pre{white-space:pre-wrap}h1{font-size:24px}</style><h1>EAF application logs</h1>"
    "<p id=s>Connecting...</p><pre id=l></pre><script>"
    "async function poll(){const abort=new AbortController();const "
    "timer=setTimeout(()=>abort.abort(),4000);try{const r=await "
    "fetch('/logs',{cache:'no-store',signal:abort.signal});"
    "if(!r.ok)throw Error(r.status);document.getElementById('l').textContent=await r.text();"
    "document.getElementById('s').textContent='Connected · '+new Date().toLocaleTimeString();}"
    "catch(e){document.getElementById('s').textContent='Disconnected — retrying';}"
    "finally{clearTimeout(timer);setTimeout(poll,2000);}}poll();</script>";
static char response[4096];
static K_THREAD_STACK_DEFINE(web_stack, 3072);
static struct k_thread web_thread;
static bool send_all(int fd, const char *data, size_t length) {
    int64_t deadline = k_uptime_get() + 500;
    while (length) {
        if (k_uptime_get() >= deadline)
            return false;
        ssize_t n = zsock_send(fd, data, length, 0);
        if (n <= 0)
            return false;
        data += (size_t)n;
        length -= (size_t)n;
    }
    return true;
}
static void serve(int fd) {
    struct zsock_timeval timeout = {.tv_sec = 0, .tv_usec = 300000};
    if (zsock_setsockopt(fd, SOL_SOCKET, SO_RCVTIMEO, &timeout, sizeof(timeout)) ||
        zsock_setsockopt(fd, SOL_SOCKET, SO_SNDTIMEO, &timeout, sizeof(timeout))) {
        board_log("Web socket setup failed errno=%d", errno);
        return;
    }
    char request[1024] = {0};
    size_t used = 0;
    int64_t deadline = k_uptime_get() + 500;
    while (used < sizeof(request) - 1u && k_uptime_get() < deadline) {
        ssize_t n = zsock_recv(fd, request + used, sizeof(request) - 1u - used, 0);
        if (n <= 0)
            return;
        used += (size_t)n;
        request[used] = '\0';
        if (strstr(request, "\r\n\r\n"))
            break;
    }
    if (!strstr(request, "\r\n\r\n"))
        return;
    const char *body;
    size_t length;
    const char *header;
    if (!strncmp(request, "GET /logs HTTP/1.", sizeof("GET /logs HTTP/1.") - 1u)) {
        body = response;
        length = board_log_read(response, sizeof(response));
        header = "HTTP/1.0 200 OK\r\nContent-Type: text/plain; charset=utf-8\r\n";
    } else if (!strncmp(request, "GET / HTTP/1.", sizeof("GET / HTTP/1.") - 1u)) {
        body = page;
        length = sizeof(page) - 1u;
        header = "HTTP/1.0 200 OK\r\nContent-Type: text/html; charset=utf-8\r\n";
    } else {
        body = "Not found\n";
        length = strlen(body);
        header = "HTTP/1.0 404 Not Found\r\nContent-Type: text/plain\r\n";
    }
    if (send_all(fd, header, strlen(header)) &&
        send_all(fd, "Cache-Control: no-store\r\nConnection: close\r\n\r\n",
                 sizeof("Cache-Control: no-store\r\nConnection: close\r\n\r\n") - 1u))
        (void)send_all(fd, body, length);
}
static void run(void *a, void *b, void *c) {
    (void)a;
    (void)b;
    (void)c;
    for (;;) {
        int listener = zsock_socket(AF_INET, SOCK_STREAM, IPPROTO_TCP);
        struct sockaddr_in address = {
            .sin_family = AF_INET, .sin_port = htons(80), .sin_addr = {.s_addr = INADDR_ANY}};
        if (listener < 0 || zsock_bind(listener, (struct sockaddr *)&address, sizeof(address)) ||
            zsock_listen(listener, 1)) {
            if (listener >= 0)
                (void)zsock_close(listener);
            k_sleep(K_SECONDS(5));
            continue;
        }
        board_log("Web diagnostics listening on port 80");
        for (;;) {
            int fd = zsock_accept(listener, NULL, NULL);
            if (fd < 0) {
                board_log("Web accept failed errno=%d", errno);
                break;
            }
            serve(fd);
            (void)zsock_close(fd);
        }
        (void)zsock_close(listener);
        k_sleep(K_SECONDS(1));
    }
}
void board_diagnostics_start(void) {
    (void)k_thread_create(&web_thread, web_stack, K_THREAD_STACK_SIZEOF(web_stack), run, NULL, NULL,
                          NULL, 7, 0, K_NO_WAIT);
}
```

## src/diagnostics.h
```c
#pragma once
#include <stddef.h>
/* Bounded application event history; concurrent writers drop rather than wait. */
void board_log(const char *format, ...) __attribute__((format(printf, 1, 2)));
/* Same history, without synchronous UART output; use for periodic telemetry. */
void board_log_memory(const char *format, ...) __attribute__((format(printf, 1, 2)));
size_t board_log_read(char *buffer, size_t capacity);
void board_diagnostics_start(void);
```

## src/log_buffer.c
```c
#include "diagnostics.h"
#include <eaf/eaf_hal.h>
#include <stdarg.h>
#include <stdio.h>
#include <string.h>
#define LOG_LINES 24u
#define LOG_WIDTH 160u
static char lines[LOG_LINES][LOG_WIDTH];
static size_t next, count;
static atomic_flag lock = ATOMIC_FLAG_INIT;
static atomic_uint dropped;
void board_log(const char *format, ...) {
    char line[LOG_WIDTH] = {0};
    int prefix = snprintf(line, sizeof(line), "[%llu ms] ",
                          (unsigned long long)(hal_monotonic_time_us() / 1000u));
    if (prefix < 0 || (size_t)prefix >= sizeof(line))
        return;
    va_list args;
    va_start(args, format);
    (void)vsnprintf(line + prefix, sizeof(line) - (size_t)prefix, format, args);
    va_end(args);
    if (atomic_flag_test_and_set(&lock)) {
        atomic_fetch_add(&dropped, 1u);
        return;
    }
    memcpy(lines[next], line, sizeof(line));
    next = (next + 1u) % LOG_LINES;
    if (count < LOG_LINES)
        ++count;
    atomic_flag_clear(&lock);
    /* UART remains useful before Wi-Fi comes up. No logging in the hot path. */
    printf("%s\n", line);
}
size_t board_log_read(char *buffer, size_t capacity) {
    if (!buffer || !capacity)
        return 0;
    int n =
        snprintf(buffer, capacity, "Application diagnostics; dropped=%u\n", atomic_load(&dropped));
    if (n < 0)
        return 0;
    size_t used = (size_t)n < capacity ? (size_t)n : capacity - 1u;
    if (atomic_flag_test_and_set(&lock))
        return used;
    for (size_t i = 0; i < count; ++i) {
        const char *line = lines[(next + LOG_LINES - count + i) % LOG_LINES];
        size_t length = strlen(line);
        if (length + 1u >= capacity - used)
            break;
        memcpy(buffer + used, line, length);
        used += length;
        buffer[used++] = '\n';
    }
    buffer[used] = '\0';
    atomic_flag_clear(&lock);
    return used;
}
```

## src/output.c
```c
#include "output.h"
#include "diagnostics.h"

/* Adapts the LMS client callbacks to the protocol-agnostic output owner. */
static void lms_log(const char *message) {
    board_log("%s", message);
}

int board_output_init(void) {
    int32_t *storage_store;
    uint32_t storage_frames;
    int rc = eaf_board_output_storage(&storage_store, &storage_frames);
    if (rc)
        return rc;
    eaf_board_output_config_t config = {.audio_cpu = CONFIG_EAF_BOARD_AUDIO_CPU,
                                        .log = lms_log,
                                        .storage = storage_store,
                                        .capacity_frames = storage_frames};
    return eaf_board_output_init(&config);
}

static int lms_start(void *ctx, const eaf_format_t *format) {
    (void)ctx;
    return eaf_board_output_start(format, eaf_board_output_capacity_frames() * 3u / 4u, false);
}

static int lms_start_buffered(void *ctx, const eaf_format_t *format,
                              const eaf_lms_buffer_request_t *request,
                              eaf_lms_buffer_limits_t *limits) {
    (void)ctx;
    int rc = eaf_lms_buffer_limits(format, request, eaf_board_output_capacity_frames(),
                                   eaf_board_output_capacity_frames() * 3u / 4u, limits);
    if (rc)
        return rc;
    board_log("Buffer request=%u B/%u ms ready=%u/%u frames clamped=%u", request->stream_bytes,
              request->output_ms, limits->ready_frames, limits->capacity_frames,
              limits->clamped ? 1u : 0u);
    return eaf_board_output_start(format, limits->ready_frames, true);
}

static uint32_t lms_pcm(void *ctx, const int32_t *samples, uint32_t frames) {
    (void)ctx;
    return eaf_board_output_write(samples, frames);
}

static void lms_eof(void *ctx) {
    (void)ctx;
    eaf_board_output_finish();
}

static void lms_stop(void *ctx) {
    (void)ctx;
    eaf_board_output_stop();
}

static int lms_pause_output(void *ctx, bool paused) {
    (void)ctx;
    return eaf_board_output_pause(paused);
}

static int lms_set_volume(void *ctx, int32_t left, int32_t right) {
    (void)ctx;
    return eaf_board_output_volume(left, right);
}

static int lms_release_output(void *ctx) {
    (void)ctx;
    return eaf_board_output_release();
}

eaf_lms_callbacks_t board_output_callbacks(void) {
    return (eaf_lms_callbacks_t){.start = lms_start,
                                 .pcm = lms_pcm,
                                 .eof = lms_eof,
                                 .stop = lms_stop,
                                 .pause = lms_pause_output,
                                 .volume = lms_set_volume,
                                 .start_buffered = lms_start_buffered,
                                 .release = lms_release_output};
}

bool board_output_failed(void) {
    return eaf_board_output_failed();
}

bool board_output_snapshot(eaf_lms_playback_t *snapshot) {
    eaf_board_playback_t generic;
    if (!eaf_board_output_snapshot(&generic))
        return false;
    *snapshot = (eaf_lms_playback_t){generic.elapsed_ms, generic.buffer_bytes, generic.queued_bytes,
                                     generic.started};
    return true;
}

uint32_t board_output_underruns(void) {
    return eaf_board_output_underruns();
}
uint32_t board_output_queue_min(void) {
    return eaf_board_output_queue_min();
}
uint32_t board_output_process_calls(void) {
    return eaf_board_output_process_calls();
}
uint32_t board_output_flags(void) {
    return eaf_board_output_flags();
}
```

## src/output.h
```c
#pragma once
#include <board_output.h>
#include <eaf/eaf_lms_client.h>

int board_output_init(void);
eaf_lms_callbacks_t board_output_callbacks(void);
bool board_output_failed(void);
uint32_t board_output_underruns(void);
uint32_t board_output_queue_min(void);
uint32_t board_output_process_calls(void);
/* Transport-thread snapshot: active=1, released=2, pause request=4, ack=8, done=16. */
uint32_t board_output_flags(void);
bool board_output_snapshot(eaf_lms_playback_t *snapshot);
```

## src/output_i2s.c
```c
#include "output.h"
#include <eaf/eaf_sink_i2s.h>
#include <zephyr/device.h>
#include <zephyr/devicetree.h>
eaf_sink_t *board_sink(void) {
    return &eaf_zephyr_i2s_sink;
}
int board_sink_init(void) {
    return eaf_zephyr_i2s_bind(DEVICE_DT_NAME(DT_NODELABEL(i2s0)));
}
int board_sink_pause(bool paused) {
    return eaf_zephyr_i2s_pause(paused);
}
```

## src/output_null.c
```c
#include "output.h"
#include <eaf/eaf_sink_null.h>
static eaf_null_sink_ctx_t context;
static eaf_sink_t sink = {&eaf_null_sink_ops, &context};
static uint64_t paused_at;
eaf_sink_t *board_sink(void) {
    return &sink;
}
int board_sink_init(void) {
    return EAF_OK;
}
int board_sink_pause(bool paused) {
    if (paused)
        paused_at = hal_monotonic_time_us();
    else
        context.epoch_us += hal_monotonic_time_us() - paused_at;
    return EAF_OK;
}
```
