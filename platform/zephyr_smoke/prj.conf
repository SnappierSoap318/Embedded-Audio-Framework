## CMakeLists.txt
```
cmake_minimum_required(VERSION 3.20.0)
list(APPEND ZEPHYR_EXTRA_MODULES ${CMAKE_CURRENT_LIST_DIR}/../..)
find_package(Zephyr REQUIRED HINTS $ENV{ZEPHYR_BASE})
project(eaf_smoke)
target_sources(app PRIVATE src/main.c src/mock_i2s.c)
target_sources_ifdef(CONFIG_EAF_BT_SBC app PRIVATE src/sbc_smoke.c)
target_sources_ifndef(CONFIG_EAF_BT_SBC app PRIVATE src/sbc_smoke_null.c)

# Test the A2DP callback boundary without enabling a host/controller. Never mix
# the registration mocks with the real Bluetooth stack.
if(CONFIG_BT OR CONFIG_EAF_BT_A2DP)
  message(FATAL_ERROR "Use a board application for Bluetooth; this sample mocks A2DP registration")
endif()
target_sources(app PRIVATE src/bt_smoke.c ../../hal/zephyr/bt_a2dp_zephyr.c)
set_source_files_properties(src/bt_smoke.c ../../hal/zephyr/bt_a2dp_zephyr.c
  PROPERTIES COMPILE_DEFINITIONS "CONFIG_BT_A2DP_SINK=1;CONFIG_BT_BUF_EVT_RX_COUNT=4;CONFIG_BT_BUF_ACL_TX_COUNT=3")
```

## sample.yaml
```
sample:
  name: EAF static HAL and audio smoke
common:
  tags: audio
  harness: console
  harness_config:
    type: one_line
    regex:
      - "EAF smoke PASS"
tests:
  eaf.smoke:
    platform_allow:
      - native_sim/native/64
    integration_platforms:
      - native_sim/native/64
```

## prj.conf
```kconfig
CONFIG_EAF=y
CONFIG_EAF_LMS=y
CONFIG_EAF_BT_INGRESS=y
CONFIG_MAIN_STACK_SIZE=4096
CONFIG_HEAP_MEM_POOL_SIZE=0
CONFIG_REQUIRES_FULL_LIBC=y
CONFIG_MAIN_THREAD_PRIORITY=0
CONFIG_I2S=y
CONFIG_EAF_I2S=y
```

## affinity.conf
```kconfig
# Exercise the optional CPU-mask path on native_sim CPU 0 (not SMP qualification).
CONFIG_SCHED_SIMPLE=y
CONFIG_SCHED_CPU_MASK=y
```

## network_bt.conf
```kconfig
CONFIG_NETWORKING=y
CONFIG_NET_IPV4=y
CONFIG_NET_IPV6=n
CONFIG_NET_TCP=y
CONFIG_NET_SOCKETS=y
CONFIG_NET_LOOPBACK=y
CONFIG_NET_DRIVERS=y
CONFIG_NET_L2_ETHERNET=n
CONFIG_EAF_LMS_CLIENT=y
CONFIG_EAF_BT_SBC=y
```

## src/main.c
```c
#include <eaf/eaf_bt.h>
#include <eaf/eaf_core.h>
#include <eaf/eaf_lms.h>
#include <eaf/eaf_sink_i2s.h>
#include <eaf/eaf_sink_null.h>
#include <zephyr/kernel.h>
static eaf_reservoir_t reservoir;
static int32_t storage[256];
static eaf_null_sink_ctx_t sink_ctx;
static eaf_pipeline_t pipeline;
static eaf_sem_t ready;
static eaf_bt_ingress_t bt;
static eaf_lms_parser_t lms;
static int packets;
static int scheduling_result;
extern unsigned eaf_mock_commits;
extern int32_t eaf_mock_last;
extern bool eaf_mock_fail_write, eaf_mock_fail_start, eaf_mock_fail_drop, eaf_mock_fail_drain;
extern bool eaf_mock_require_drain;
extern int eaf_sbc_smoke(void);
extern int eaf_bt_smoke(void);
static int packet(void *ctx, const uint8_t *data, size_t length) {
    (void)ctx;
    (void)data;
    if (length != 4)
        return EAF_INVALID;
    ++packets;
    return EAF_OK;
}
static void producer(void *ctx) {
    (void)ctx;
    int32_t samples[64];
    for (size_t i = 0; i < 64; ++i)
        samples[i] = (int32_t)i;
    (void)eaf_reservoir_write(&reservoir, samples, 32);
    eaf_reservoir_finish(&reservoir);
    hal_sem_give(&ready);
}
static void scheduling_worker(void *ctx) {
    const int *priority = ctx;
    scheduling_result = k_thread_priority_get(k_current_get()) == *priority ? EAF_OK : EAF_IO;
    hal_sem_give(&ready);
}
static int scheduling_smoke(void) {
    if (hal_sem_take(&ready, 0) != EAF_TIMEOUT)
        return EAF_IO;
    uint64_t before = hal_monotonic_time_us();
    if (hal_sem_take(&ready, 10) != EAF_TIMEOUT || hal_monotonic_time_us() - before < 10000u)
        return EAF_IO;
    hal_sem_give(&ready);
    hal_sem_give(&ready);
    if (hal_sem_take(&ready, 0) || hal_sem_take(&ready, 0) != EAF_TIMEOUT)
        return EAF_IO;
    for (unsigned i = 0; i < 8; ++i) {
        eaf_thread_t thread = {0};
        eaf_thread_options_t options = {i & 1u ? EAF_THREAD_AUDIO : EAF_THREAD_DECODER, -1, false};
        int priority = i & 1u ? CONFIG_EAF_AUDIO_PRIORITY : CONFIG_EAF_DECODER_PRIORITY;
        int rc = hal_thread_create_with_options(&thread, scheduling_worker, &priority, &options);
        if (rc)
            return rc;
        int waited = hal_sem_take(&ready, 1000);
        int joined = hal_thread_join(&thread);
        if (waited || joined || scheduling_result)
            return EAF_IO;
    }
    eaf_thread_t thread = {0};
    eaf_thread_options_t options = {EAF_THREAD_AUDIO, 0, false};
    int priority = CONFIG_EAF_AUDIO_PRIORITY;
    int rc = hal_thread_create_with_options(&thread, scheduling_worker, &priority, &options);
    if (rc == EAF_UNSUPPORTED) {
        /* Affinity is not built in: the request must leave no thread handle. */
        if (thread.impl)
            return EAF_IO;
    } else if (rc || hal_sem_take(&ready, 1000) || hal_thread_join(&thread) || scheduling_result) {
        return EAF_IO;
    }
    return EAF_OK;
}
int main(void) {
    eaf_format_t fmt = {48000, 2, 3};
    eaf_sink_t sink = {&eaf_null_sink_ops, &sink_ctx};
    eaf_pipeline_config_t config = {&reservoir, NULL, 0, &sink};
    eaf_thread_t worker = {0};
    int rc = eaf_reservoir_init(&reservoir, storage, 128, fmt, 64);
    if (!rc)
        rc = hal_sem_init(&ready);
    if (!rc)
        rc = scheduling_smoke();
    if (!rc)
        rc = eaf_pipeline_init(&pipeline, &config);
    if (!rc)
        rc = eaf_pipeline_configure(&pipeline, 32);
    if (!rc)
        rc = eaf_pipeline_start(&pipeline);
    /* Static Zephyr pool, no heap allocation even when creating this worker. */
    if (!rc)
        rc = hal_thread_create(&worker, producer, NULL);
    if (!rc)
        rc = hal_sem_take(&ready, 1000);
    if (!rc)
        rc = hal_thread_join(&worker);
    if (!rc && eaf_pipeline_process(&pipeline) != EAF_EOF)
        rc = EAF_IO;
    if (!rc && (reservoir.frames_read != 32 || sink_ctx.samples[0][63] != 63))
        rc = EAF_IO;
    if (!rc)
        rc = eaf_pipeline_stop(&pipeline);
    if (!rc)
        rc = eaf_pipeline_deinit(&pipeline);
    hal_sem_deinit(&ready);
    const uint8_t frame[] = {0, 4, 'a', 'u', 'd', 'e'};
    eaf_lms_parser_init(&lms, packet, NULL);
    if (!rc)
        rc = eaf_lms_feed(&lms, frame, sizeof(frame));
    if (!rc && packets != 1)
        rc = EAF_IO;
    eaf_bt_ingress_init(&bt);
    const uint8_t sbc[] = {1, 0x9c, 0, 0, 0};
    static eaf_bt_packet_t out;
    if (!rc)
        rc = eaf_bt_sbc_receive(&bt, 1, 0, sbc, sizeof(sbc));
    if (!rc && !eaf_bt_ingress_pop(&bt, &out))
        rc = EAF_IO;
    if (!rc)
        rc = eaf_zephyr_i2s_bind("eaf_mock_i2s");
    eaf_sink_t *tx = &eaf_zephyr_i2s_sink;
    if (!rc)
        rc = tx->ops->init(tx, &fmt, 32);
    /* More than four restarts verifies that STOP releases failed-write buffers. */
    for (unsigned cycle = 0; !rc && cycle < 10; ++cycle) {
        rc = tx->ops->start(tx);
        eaf_buffer_t *b = NULL;
        if (!rc)
            rc = tx->ops->acquire_buf(tx, &b);
        if (!rc) {
            for (size_t i = 0; i < 64; ++i)
                b->samples[i] = (int32_t)i;
            eaf_mock_fail_write = (cycle & 1u) != 0;
            eaf_mock_fail_start = !eaf_mock_fail_write;
            int result = tx->ops->commit_buf(tx, b);
            if (result != EAF_IO)
                rc = EAF_IO;
        }
        eaf_mock_fail_drop = true;
        if (!rc && (tx->ops->stop(tx) != EAF_IO || tx->ops->deinit(tx) != EAF_IO ||
                    tx->ops->start(tx) != EAF_STATE))
            rc = EAF_IO;
        eaf_mock_fail_drop = false;
        if (!rc)
            rc = tx->ops->stop(tx);
    }
    if (!rc && (eaf_mock_commits != 5 || eaf_mock_last != 63))
        rc = EAF_IO;
    eaf_mock_fail_start = eaf_mock_fail_write = false;
    for (unsigned cycle = 0; !rc && cycle < 2; ++cycle) {
        rc = tx->ops->start(tx);
        eaf_buffer_t *b = NULL;
        if (!rc)
            rc = tx->ops->acquire_buf(tx, &b);
        if (!rc) {
            b->flags = EAF_FRAME_EOS;
            eaf_mock_fail_drain = cycle == 0;
            if (tx->ops->commit_buf(tx, b) != (eaf_mock_fail_drain ? EAF_IO : EAF_OK))
                rc = EAF_IO;
        }
        if (!rc && eaf_mock_fail_drain && tx->ops->stop(tx) != EAF_IO)
            rc = EAF_IO;
        eaf_mock_fail_drain = false; /* Retry cleanup once the backend recovers. */
        if (!rc)
            rc = tx->ops->stop(tx);
    }
    eaf_mock_fail_drain = false;
    if (!rc)
        rc = tx->ops->start(tx);
    if (!rc)
        rc = eaf_zephyr_i2s_pause(true);
    eaf_buffer_t *paused_buffer = NULL;
    if (!rc && tx->ops->acquire_buf(tx, &paused_buffer) != EAF_STATE)
        rc = EAF_IO;
    if (!rc)
        rc = eaf_zephyr_i2s_pause(false);
    if (!rc)
        rc = tx->ops->acquire_buf(tx, &paused_buffer);
    if (!rc) {
        paused_buffer->flags = 0;
        rc = tx->ops->commit_buf(tx, paused_buffer);
    }
    eaf_mock_fail_drain = true;
    if (!rc && eaf_zephyr_i2s_pause(true) != EAF_IO)
        rc = EAF_IO;
    eaf_mock_fail_drain = false;
    if (!rc)
        rc = eaf_zephyr_i2s_pause(true);
    if (!rc)
        rc = eaf_zephyr_i2s_pause(false);
    if (!rc)
        rc = tx->ops->acquire_buf(tx, &paused_buffer);
    if (!rc) {
        paused_buffer->flags = 0;
        rc = tx->ops->commit_buf(tx, paused_buffer);
    }
    if (!rc)
        rc = tx->ops->stop(tx);
    /* Track cancellation must retire in-flight DMA before DROP, including when
       the producer owns another uncommitted block. Repeat beyond pool capacity. */
    eaf_mock_require_drain = true;
    for (unsigned cycle = 0; !rc && cycle < 10; ++cycle) {
        rc = tx->ops->start(tx);
        eaf_buffer_t *b = NULL;
        if (!rc)
            rc = tx->ops->acquire_buf(tx, &b);
        if (!rc) {
            b->flags = 0;
            rc = tx->ops->commit_buf(tx, b);
        }
        if (!rc)
            rc = tx->ops->acquire_buf(tx, &b);
        if (!rc)
            rc = tx->ops->stop(tx);
    }
    eaf_mock_require_drain = false;
    int cleanup = tx->ops->deinit(tx);
    if (!rc)
        rc = cleanup;
    if (!rc)
        rc = eaf_sbc_smoke();
    if (rc == EAF_OK)
        rc = eaf_bt_smoke();
    printk("EAF smoke %s (%d)\n", rc ? "FAIL" : "PASS", rc);
    return rc;
}
```

## src/bt_smoke.c
```c
/* Exercise the adapter against the pinned Zephyr API without a radio. */
#include <eaf/eaf_bt_zephyr.h>
#include <errno.h>
#include <zephyr/bluetooth/classic/a2dp.h>
#include <zephyr/bluetooth/classic/a2dp_codec_sbc.h>

static struct bt_a2dp_cb *cb;
static struct bt_a2dp_ep *ep;
static struct bt_a2dp_stream *registered_stream;
static eaf_bt_ingress_t queue;
static eaf_bt_packet_t packet;
static unsigned events;
int bt_a2dp_register_cb(struct bt_a2dp_cb *callbacks) {
    cb = callbacks;
    return 0;
}
int bt_a2dp_register_ep(struct bt_a2dp_ep *endpoint, uint8_t media_type, uint8_t sep_type) {
    if (media_type != BT_AVDTP_AUDIO || sep_type != BT_AVDTP_SINK)
        return -EINVAL;
    ep = endpoint;
    return 0;
}
void bt_a2dp_stream_cb_register(struct bt_a2dp_stream *stream, struct bt_a2dp_stream_ops *ops) {
    registered_stream = stream;
    stream->ops = ops;
}
static void event(void *ctx, eaf_bt_zephyr_event_t value) {
    (void)ctx;
    events |= 1u << (unsigned)value;
}
int eaf_bt_smoke(void) {
    eaf_bt_ingress_init(&queue);
    if (eaf_bt_zephyr_register(&queue, 32000, event, NULL) != -EINVAL ||
        eaf_bt_zephyr_register(&queue, 48000, event, NULL) ||
        eaf_bt_zephyr_register(&queue, 48000, event, NULL) != -EALREADY)
        return -1;
    struct bt_a2dp_codec_ie ie = {.len = 4, .codec_ie = {0x11, 0x15, 2, 53}};
    struct bt_a2dp_codec_cfg cfg = {.codec_config = &ie};
    struct bt_a2dp_stream *stream = NULL;
    uint8_t error = 0;
    if (cb->config_req(NULL, ep, &cfg, &stream, &error) || stream != registered_stream)
        return -2;
    ie.codec_ie[0] = 0x31; /* Multiple sample rates are not a configuration. */
    if (!cb->reconfig_req(stream, &cfg, &error) ||
        error != BT_A2DP_NOT_SUPPORTED_SAMPLING_FREQUENCY)
        return -3;
    ie.codec_ie[0] = 0x13; /* Multiple channel modes. */
    if (!cb->reconfig_req(stream, &cfg, &error) || error != BT_A2DP_INVALID_CHANNEL_MODE)
        return -4;
    ie.codec_ie[0] = 0x11;
    ie.codec_ie[3] = 54;
    if (!cb->reconfig_req(stream, &cfg, &error) || error != BT_A2DP_INVALID_MAXIMUM_BITPOOL_VALUE)
        return -5;
    stream->ops->configured(stream);
    uint8_t media[] = {1, 0x9c, 0};
    struct net_buf buf = {0};
    net_buf_simple_init_with_data(&buf.b, media, sizeof(media));
    stream->ops->recv(stream, &buf, 1, 128);
    if (eaf_bt_ingress_pop(&queue, &packet))
        return -6;
    stream->ops->started(stream);
    stream->ops->recv(stream, &buf, 1, 128);
    if (!eaf_bt_ingress_pop(&queue, &packet) || !packet.discontinuity || packet.sequence != 1 ||
        packet.timestamp != 128 || packet.length != 2 || packet.data[0] != 0x9c)
        return -7;
    stream->ops->suspended(stream);
    stream->ops->recv(stream, &buf, 2, 256);
    if (eaf_bt_ingress_pop(&queue, &packet))
        return -8;
    stream->ops->started(stream);
    stream->ops->recv(stream, &buf, 3, 384);
    if (!eaf_bt_ingress_pop(&queue, &packet) || !packet.discontinuity)
        return -9;
    stream->ops->released(stream);
    stream->ops->recv(stream, &buf, 4, 512);
    if (eaf_bt_ingress_pop(&queue, &packet) || events != 15u)
        return -10;
    return 0;
}
```

## src/mock_i2s.c
```c
/* Test-only I2S device: models slab ownership, not DMA timing. */
#include <errno.h>
#include <zephyr/device.h>
#include <zephyr/drivers/i2s.h>
#include <zephyr/kernel.h>
static struct i2s_config config;
static void *pending;
static bool started;
unsigned eaf_mock_commits;
int32_t eaf_mock_last;
bool eaf_mock_fail_write, eaf_mock_fail_start, eaf_mock_fail_drop, eaf_mock_fail_drain;
bool eaf_mock_require_drain;
static int configure(const struct device *dev, enum i2s_dir dir, const struct i2s_config *cfg) {
    (void)dev;
    if (dir != I2S_DIR_TX || cfg->word_size != 32 || cfg->channels != 2)
        return -EINVAL;
    config = *cfg;
    return 0;
}
static int write_block(const struct device *dev, void *block, size_t bytes) {
    (void)dev;
    if (eaf_mock_fail_write || pending || bytes != config.block_size)
        return -EIO;
    eaf_mock_last = ((int32_t *)block)[bytes / sizeof(int32_t) - 1u];
    ++eaf_mock_commits;
    if (started)
        k_mem_slab_free(config.mem_slab, block);
    else
        pending = block;
    return 0;
}
static int trigger(const struct device *dev, enum i2s_dir dir, enum i2s_trigger_cmd cmd) {
    (void)dev;
    (void)dir;
    if (cmd == I2S_TRIGGER_START) {
        if (eaf_mock_fail_start || !pending)
            return -EIO;
        started = true;
    } else if (cmd == I2S_TRIGGER_DRAIN) {
        if (eaf_mock_fail_drain)
            return -EIO;
        started = false;
    } else if (cmd == I2S_TRIGGER_DROP) {
        /* Model a DMA backend whose active block must complete before DROP. */
        if (eaf_mock_fail_drop || (eaf_mock_require_drain && started && pending))
            return -EIO;
        started = false;
    } else
        return -EINVAL;
    if (pending && !(eaf_mock_require_drain && cmd == I2S_TRIGGER_START)) {
        k_mem_slab_free(config.mem_slab, pending);
        pending = NULL;
    }
    return 0;
}
static DEVICE_API(i2s, api) = {.configure = configure, .write = write_block, .trigger = trigger};
DEVICE_DEFINE(eaf_test_i2s, "eaf_mock_i2s", NULL, NULL, NULL, NULL, POST_KERNEL, 50, &api);
```

## src/sbc_smoke.c
```c
#include <eaf/eaf_sbc_oi.h>
#include <string.h>
static const uint8_t encoded[] = {
#include "../../../tests/fixtures/tone_sbc.inc"
};
static eaf_sbc_oi_t codec;
static eaf_bt_ingress_t queue;
static eaf_bt_decoder_t worker;
static eaf_reservoir_t reservoir;
static int32_t storage[1024];
int eaf_sbc_smoke(void) {
    eaf_sbc_decoder_t decoder;
    int rc = eaf_sbc_oi_init(&codec, &decoder);
    eaf_format_t fmt = {48000, 2, 3};
    if (!rc)
        rc = eaf_reservoir_init(&reservoir, storage, 512, fmt, 256);
    eaf_bt_ingress_init(&queue);
    if (!rc)
        rc = eaf_bt_decoder_init(&worker, &queue, &reservoir, &decoder);
    uint8_t payload[sizeof(encoded) + 1u];
    payload[0] = 4;
    memcpy(payload + 1, encoded, sizeof(encoded));
    if (!rc)
        rc = eaf_bt_sbc_receive(&queue, 0, 0, payload, sizeof(payload));
    for (unsigned i = 0; !rc && i < 8; ++i)
        rc = eaf_bt_decoder_step(&worker);
    if (!rc && eaf_reservoir_level(&reservoir) != 512)
        rc = EAF_IO;
    return rc;
}
```

## src/sbc_smoke_null.c
```c
int eaf_sbc_smoke(void) {
    return 0;
}
```
